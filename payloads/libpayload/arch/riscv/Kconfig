## payloads/libpayload/arch/riscv/Kconfig
```kconfig
## SPDX-License-Identifier: GPL-2.0-only

if ARCH_RISCV_RV64

config ARCH_SPECIFIC_OPTIONS
	def_bool y
	select LITTLE_ENDIAN

endif
```

## src/acpi/Kconfig
```kconfig
config ACPI_SATA_GENERATOR
	bool
	default n
	help
	  Use ACPI SATA port generator.

config ACPI_INTEL_HARDWARE_SLEEP_VALUES
	def_bool n
	help
	  Provide common definitions for Intel hardware PM1_CNT register sleep
	  values.

config ACPI_AMD_HARDWARE_SLEEP_VALUES
	def_bool n
	help
	  Provide common definitions for AMD hardware PM1_CNT register sleep
	  values.

config ACPI_WDAT_WDT
	bool
	default n
	depends on HAVE_ACPI_TABLES
	help
	  Selected by platforms that support and fill ACPI Watchdog Action Table
	  (WDAT).
```

## src/ec/amd/mandolin-ec/Kconfig
```kconfig
config EC_AMD_MANDOLIN_EC
	bool
	select EC_ACPI
	help
	  Enable some support for embedded controller on Mandolin boards.
```

## src/mainboard/google/brya/Kconfig.name
```kconfig
comment "Brya"

config BOARD_GOOGLE_AGAH
	bool "->  Agah"

config BOARD_GOOGLE_ANAHERA
	bool "->  Anahera"

config BOARD_GOOGLE_ANAHERA4ES
	bool "->  Anahera4ES"

config BOARD_GOOGLE_AURASH
	bool "->  Aurash"

config BOARD_GOOGLE_BANSHEE
	bool "->  Banshee"

config BOARD_GOOGLE_BRASK
	bool "->  Brask"

config BOARD_GOOGLE_BRYA0
	bool "->  Brya 0"

config BOARD_GOOGLE_BRYA4ES
	bool "->  Brya4ES"

config BOARD_GOOGLE_CONSTITUTION
	bool "->  Constitution"

config BOARD_GOOGLE_CRAASK
	bool "->  Craask"

config BOARD_GOOGLE_CROTA
	bool "->  Crota"

config BOARD_GOOGLE_DOCHI
	bool "->  Dochi"

config BOARD_GOOGLE_FELWINTER
	bool "->  Felwinter"

config BOARD_GOOGLE_GAELIN
	bool "->  Gaelin"

config BOARD_GOOGLE_GHOST
	bool "->  Ghost"

config BOARD_GOOGLE_GHOST4ADL
	bool "->  Ghost4ADL"

config BOARD_GOOGLE_GHOST4ES
	bool "->  Ghost4ES"

config BOARD_GOOGLE_GIMBLE
	bool "->  Gimble"

config BOARD_GOOGLE_GIMBLE4ES
	bool "->  Gimble4ES"

config BOARD_GOOGLE_GLADIOS
	bool "->  Gladios"

config BOARD_GOOGLE_HADES
	bool "->  Hades"

config BOARD_GOOGLE_KANO
	bool "->  Kano"

config BOARD_GOOGLE_KINOX
	bool "->  Kinox"

config BOARD_GOOGLE_KULDAX
	bool "->  Kuldax"

config BOARD_GOOGLE_LISBON
	bool "->  Lisbon"

config BOARD_GOOGLE_MARASOV
	bool "->  Marasov"

config BOARD_GOOGLE_MITHRAX
	bool "->  Mithrax"

config BOARD_GOOGLE_MOLI
	bool "->  Moli"

config BOARD_GOOGLE_MOXIE
	bool "->  Moxie"

config BOARD_GOOGLE_NEREID
	bool "->  Nereid"

config BOARD_GOOGLE_NIVVIKS
	bool "->  Nivviks"

config BOARD_GOOGLE_OMNIGUL
	bool "->  Omnigul"

config BOARD_GOOGLE_OSIRIS
	bool "->  Osiris"

config BOARD_GOOGLE_PRIMUS
	bool "->  Primus"

config BOARD_GOOGLE_PRIMUS4ES
	bool "->  Primus4ES"

config BOARD_GOOGLE_REDRIX
	bool "->  Redrix"

config BOARD_GOOGLE_REDRIX4ES
	bool "->  Redrix4ES"

config BOARD_GOOGLE_SKOLAS
	bool "->  Skolas"

config BOARD_GOOGLE_SKOLAS4ES
	bool "->  Skolas4ES"

config BOARD_GOOGLE_TAEKO
	bool "->  Taeko"

config BOARD_GOOGLE_TAEKO4ES
	bool "->  Taeko4ES"

config BOARD_GOOGLE_TANIKS
	bool "->  Taniks"

config BOARD_GOOGLE_VELL
	bool "->  Vell"

config BOARD_GOOGLE_VOLMAR
	bool "->  Volmar"

config BOARD_GOOGLE_ZYDRON
	bool "->  Zydron"

config BOARD_GOOGLE_XOL
	bool "->  Xol"

config BOARD_GOOGLE_NOVA
	bool "->  Nova"

config BOARD_GOOGLE_BUJIA
	bool "->  Bujia"
```

## src/mainboard/google/zork/Kconfig
```kconfig
# SPDX-License-Identifier: GPL-2.0-or-later

config BOARD_GOOGLE_BASEBOARD_TREMBYLE
	def_bool n
	select AMD_FP5

config BOARD_GOOGLE_BASEBOARD_DALBOZ
	def_bool n
	select AMD_FT5

if BOARD_GOOGLE_BASEBOARD_TREMBYLE || BOARD_GOOGLE_BASEBOARD_DALBOZ

config BOARD_SPECIFIC_OPTIONS
	def_bool y
	select SOC_AMD_COMMON_BLOCK_USE_ESPI
	select SOC_AMD_PICASSO
	select VGA_BIOS
	select BOARD_ROMSIZE_KB_16384
	select DISABLE_SPI_FLASH_ROM_SHARING
	select DRIVERS_GENERIC_GPIO_KEYS
	select DRIVERS_I2C_GENERIC
	select DRIVERS_I2C_HID
	select EC_GOOGLE_CHROMEEC
	select EC_GOOGLE_CHROMEEC_BOARDID
	select EC_GOOGLE_CHROMEEC_ESPI
	select EC_GOOGLE_CHROMEEC_I2C_TUNNEL
	select EC_GOOGLE_CHROMEEC_SKUID
	select EC_GOOGLE_CHROMEEC_SWITCHES
	select ELOG
	select ELOG_BOOT_COUNT
	select ELOG_GSMI
	select HAVE_ACPI_TABLES
	select GFXUMA
	select GOOGLE_SMBIOS_MAINBOARD_VERSION
	select MAINBOARD_HAS_CHROMEOS
	select PICASSO_UART
	select MAINBOARD_HAS_I2C_TPM_CR50
	select MAINBOARD_HAS_TPM2
	select PCIEXP_ASPM
	select PCIEXP_CLK_PM
	select PCIEXP_COMMON_CLOCK
	select PCIEXP_L1_SUB_STATE
	select HAVE_EM100_SUPPORT
	select SYSTEM_TYPE_LAPTOP
	select DRIVERS_GENERIC_MAX98357A
	select HAVE_ACPI_RESUME
	select DRIVERS_USB_ACPI
	select DRIVERS_UART_ACPI
	select PSP_UNLOCK_SECURE_DEBUG

config ELOG_BOOT_COUNT_CMOS_OFFSET
	int
	default 144

# FMDFILE is set here so that coreboot build picks up this flash map layout
# even when CHROMEOS is not selected when building upstream.
config FMDFILE
	string
	default "src/mainboard/$(CONFIG_MAINBOARD_DIR)/chromeos.fmd"

config MAINBOARD_DIR
	string
	default google/zork

config VGA_BIOS_ID

config VGA_BIOS_FILE
	string
	default "3rdparty/blobs/mainboard/google/zork/PicassoGenericVbios.bin"

config VARIANT_DIR
	string
	default "ezkinil" if BOARD_GOOGLE_EZKINIL
	default "morphius" if BOARD_GOOGLE_MORPHIUS
	default "trembyle" if BOARD_GOOGLE_TREMBYLE
	default "dalboz" if BOARD_GOOGLE_DALBOZ
	default "berknip" if BOARD_GOOGLE_BERKNIP
	default "vilboz" if BOARD_GOOGLE_VILBOZ

config MAINBOARD_PART_NUMBER
	string
	default "Ezkinil" if BOARD_GOOGLE_EZKINIL
	default "Morphius" if BOARD_GOOGLE_MORPHIUS
	default "Trembyle" if BOARD_GOOGLE_TREMBYLE
	default "Dalboz" if BOARD_GOOGLE_DALBOZ
	default "Berknip" if BOARD_GOOGLE_BERKNIP
	default "Vilboz" if BOARD_GOOGLE_VILBOZ

config DEVICETREE
	string
	default "variants/baseboard/devicetree.cb"

config OVERRIDE_DEVICETREE
	string
	default "variants/$(CONFIG_VARIANT_DIR)/overridetree.cb"

config MAINBOARD_FAMILY
	string
	default "Google_Zork"

config MAX_CPUS
	int
	default 8

config IRQ_SLOT_COUNT
	int
	default 11

config ONBOARD_VGA_IS_PRIMARY
	bool
	default y

config VGA_ROM_RUN
	select HAVE_VGA_TEXT_FRAMEBUFFER
	select ALWAYS_LOAD_OPROM
	select ALWAYS_RUN_OPROM
	help
	  Execute VGA Option ROMs in coreboot if found. This can be used
	  to enable PCI/AGP/PCI-E video cards when not using a SeaBIOS
	  payload.

	  When using a SeaBIOS payload it runs all option ROMs with much
	  more complete BIOS interrupt services available than coreboot,
	  which some option ROMs require in order to function correctly.

config VBOOT
	select EC_GOOGLE_CHROMEEC_SWITCHES
	select VBOOT_LID_SWITCH
	select VBOOT_STARTS_BEFORE_BOOTBLOCK

config VBOOT_VBNV_OFFSET
	hex
	default 0x2A

config CHROMEOS
	# Use default libpayload config
	select LP_DEFCONFIG_OVERRIDE if PAYLOAD_DEPTHCHARGE

config AMD_FWM_POSITION_INDEX
	int
	default 2

config DRIVER_TPM_I2C_BUS
	hex
	default 0x03

config DRIVER_TPM_I2C_ADDR
	hex
	default 0x50

config USE_OEM_BIN
	bool "Add an oem.bin file"
	help
	  Add an oem.bin file to identify the manufacturer in SMBIOS, overriding the
	  CONFIG_MAINBOARD_SMBIOS_MANUFACTURER value.

config OEM_BIN_FILE
	string "OEM ID table"
	depends on USE_OEM_BIN
	default ""

config FSP_M_FILE
	string "FSP-M (memory init) binary path and filename"
	depends on ADD_FSP_BINARIES
	default "3rdparty/amd_blobs/picasso/PICASSO_M.fd"
	help
	  The path and filename of the FSP-M binary for this platform.
	  TODO: remove this: Mandolin temporarily makes the default
	  location the coreboot root for easy internal development.

config FSP_S_FILE
	string "FSP-S (silicon init) binary path and filename"
	depends on ADD_FSP_BINARIES
	default "3rdparty/amd_blobs/picasso/PICASSO_S.fd"
	help
	  The path and filename of the FSP-S binary for this platform.
	  TODO: remove this: Mandolin temporarily makes the default
	  location the coreboot root for easy internal development.

config HAVE_APCB_BLOB
	bool "Have AGESA PSP Customization Block file?"
	default n
	help
	  The PSP requires the APCB file to know how to configure memory, as
	  well as other settings it will initialize.  To build an image that
	  will get to POST, select 'y' and provide the file path/name.  The
	  default of 'n' allows the board to build successfully but it avoids
	  redistributing the APCB blob extracted from UEFI.
	  TODO: Add the ability to construct APCB on the fly for any mainboard.

config PAYLOAD_CONFIGFILE
	string
	depends on PAYLOAD_SEABIOS
	default "$(top)/src/mainboard/google/zork/config_seabios"

#TODO: Change these to get the postition from the FMAP file
config PICASSO_FW_A_POSITION
	hex
	default 0xFF031040
	depends on VBOOT_SLOTS_RW_AB && VBOOT_STARTS_BEFORE_BOOTBLOCK
	help
	  Location of the AMD firmware in the RW_A region.

config PICASSO_FW_B_POSITION
	hex
	default 0xFF3CF040
	depends on VBOOT_SLOTS_RW_AB && VBOOT_STARTS_BEFORE_BOOTBLOCK
	help
	  Location of the AMD firmware in the RW_B region

config VARIANT_HAS_FW_CONFIG
	bool
	help
	  Honor FW_CONFIG in CBI.

config VARIANT_BOARD_VER_FW_CONFIG_VALID
	int
	default 256
	depends on VARIANT_HAS_FW_CONFIG
	help
	  Which board version did FW_CONFIG become valid in CBI.

config VARIANT_MIN_BOARD_ID_V3_SCHEMATICS
	int
	default 4 if BOARD_GOOGLE_TREMBYLE
	default 3 if BOARD_GOOGLE_EZKINIL
	default 3 if BOARD_GOOGLE_MORPHIUS
	default 2 if BOARD_GOOGLE_BERKNIP
	default 3 if BOARD_GOOGLE_DALBOZ
	default 2 if BOARD_GOOGLE_VILBOZ
	default 256

config VARIANT_MIN_BOARD_ID_WIFI_POWER_ACTIVE_LOW
	int
	default 3 if BOARD_GOOGLE_BERKNIP
	default 3 if BOARD_GOOGLE_VILBOZ
	default VARIANT_MIN_BOARD_ID_V3_SCHEMATICS

endif # BOARD_GOOGLE_BASEBOARD_TREMBYLE || BOARD_GOOGLE_BASEBOARD_DALBOZ
```

## src/mainboard/prodrive/atlas/Kconfig
```kconfig
config BOARD_PRODRIVE_ATLAS_BASEBOARD
	def_bool n
	select BOARD_ROMSIZE_KB_32768
	select HAVE_ACPI_RESUME
	select HAVE_ACPI_TABLES
	select SOC_INTEL_ENABLE_USB4_PCIE_RESOURCES
	select SOC_INTEL_ALDERLAKE_PCH_P

if BOARD_PRODRIVE_ATLAS_BASEBOARD

config ATLAS_ENABLE_SAGV
	bool "Enable SaGv"
	default n

config ATLAS_ENABLE_IBECC
	bool "Enable IBECC"
	help
	  Enables In Band Error Correction Code. It's only needed for endurance testing
	  and therefore not always required.
	default n

config D3COLD_SUPPORT
	default n

config MAINBOARD_FAMILY
	string
	default "PRODRIVE_ATLAS_SERIES"

config MAINBOARD_PART_NUMBER
	default "Atlas ADL-P"

config MAINBOARD_DIR
	default "prodrive/atlas"

config MAINBOARD_SMBIOS_MANUFACTURER
	string
	default "Prodrive Technologies B.V."

config DIMM_SPD_SIZE
	default 512

config UART_FOR_CONSOLE
	int
	default 0

endif #BOARD_PRODRIVE_ATLAS_BASEBOARD
```

## src/security/tpm/tss/vendor/cr50/Kconfig
```kconfig
# SPDX-License-Identifier: GPL-2.0-only

config TPM_CR50
	bool
	depends on TPM2
	default y if MAINBOARD_HAS_I2C_TPM_CR50 || MAINBOARD_HAS_SPI_TPM_CR50

if TPM_CR50

config POWER_OFF_ON_CR50_UPDATE
	bool
	default y if ARCH_X86
	help
	  Power off machine while waiting for CR50 update to take effect.

config CR50_USE_LONG_INTERRUPT_PULSES
	bool
	default n
	help
	  Whether to request longer interrupt pulses using Cr50 BOARD_CFG register.
	  If the Cr50 firmware is too old, it will not be able to honor the request.

config CR50_RESET_CLEAR_EC_AP_IDLE_FLAG
	def_bool n
	help
	  Select this if the variant is a Chromebox/base. This allows AP to direct EC
	  to clear AP_IDLE flag after AP shutdown before triggering CR50 reset and
	  shutting down AP so that AP can boot up after CR50 reset.

endif
```
