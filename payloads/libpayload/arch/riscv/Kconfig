## src/soc/intel/common/block/tcss/Kconfig
```kconfig
config SOC_INTEL_COMMON_BLOCK_TCSS
	def_bool n
	select FSPS_USE_MULTI_PHASE_INIT
	help
	  Sets up USB2/3 port mapping in TCSS MUX

config TCSS_HAS_USBC_OPS
	bool "Enable USB-C MUX operations via the EC"
	default y if EC_GOOGLE_CHROMEEC
	depends on SOC_INTEL_COMMON_BLOCK_TCSS
	help
	  Enable USB-C operations via the EC. Requires `usbc_get_ops` to control features
	  such as HPD and DP Mode entry. Currently, only the ChromeEC implements this, see
	  (ec/google/chromeec/usbc_mux.c).

	  This results in the MUX being set to a disabled state.

config SOC_INTEL_TCSS_USE_PDC_PMC_USBC_MUX_CONFIGURATION
	def_bool n
	help
	  TCSS uses PDC<->PMC communication to perform mux configuration. When this config is
	  enabled, communication happens directly between PDC and PMC. Avoid sending PMC
	  commands from AP/EC.

config ENABLE_TCSS_DISPLAY_DETECTION
	bool "Enable detection of displays over USB Type-C ports with TCSS"
	depends on TCSS_HAS_USBC_OPS && RUN_FSP_GOP
	help
	  Enable displays to be detected over Type-C ports during boot.
```

## src/vendorcode/google/Kconfig
```kconfig
## SPDX-License-Identifier: GPL-2.0-only

source "src/vendorcode/google/chromeos/Kconfig"

config GOOGLE_SMBIOS_MAINBOARD_VERSION
	bool
	default n
	depends on GENERATE_SMBIOS_TABLES
	help
	  Provide a common implementation for mainboard version,
	  which returns a formatted 'rev%d' board_id() string.

config GOOGLE_PVMFW_CBMEM
	bool "Enable reserving memory for pvmfw using cbmem"
	default n
	help
	  Select this config to enable allocating a region for Android protected
	  virtual machine firmware within cbmem. The region shall be filled by
	  the payload and the purpose is to just reserve the memory.
	  cbmem is used to make sure that the region won't overlap with other
	  reserved regions or device regions.

config GOOGLE_PVMFW_CBMEM_SIZE
	hex "Size of the pvmfw buffer to be reserved using cbmem"
	depends on GOOGLE_PVMFW_CBMEM
	default 0x400000
```
